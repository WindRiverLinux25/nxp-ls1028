## conf/machine/nxp-ls1028.conf
```bitbake
#@TYPE: Machine
#@NAME: nxp-ls1028
#@DESCRIPTION: Machine configuration for NXP QorIQ Layerscape 1028A SoC

DEFAULTTUNE = "cortexa72"
require conf/machine/include/arm/armv8a/tune-cortexa72.inc

MACHINE_FEATURES = "ext3 pci usbgadget usbhost vfat ext3 serial alsa network"

MACHINE_EXTRA_RRECOMMENDS += "linux-firmware-iwlwifi-8265"
MACHINE_EXTRA_RRECOMMENDS += "linux-firmware-iwlwifi-7265d"
MACHINE_EXTRA_RRECOMMENDS += "linux-firmware-ibt-12-16"
MACHINE_EXTRA_RRECOMMENDS += "linux-firmware-ibt-17"

KERNEL_IMAGETYPE = "Image"
KERNEL_DEVICETREE = "freescale/fsl-ls1028a-rdb.dtb freescale/fsl-ls1028a-rdb-dpdk.dtb"

SERIAL_CONSOLES ?= "115200;ttyS0"
SERIAL_CONSOLES_CHECK ?= "${SERIAL_CONSOLES}"

# multilib support
MULTILIBS ?= "multilib:lib32"
DEFAULTTUNE:virtclass-multilib-lib32 ?= "armv7athf-neon"

EXTRA_IMAGECMD:jffs2 = "--pad -l --eraseblock=0x20000 --no-cleanmarkers"

MACHINE_EXTRA_RRECOMMENDS = " kernel-modules kernel-devicetree"
IMAGE_FSTYPES += "tar.bz2 wic wic.bmap"
WKS_FILE ?= "ls1028-sdimage-bootpart.wks"
IMAGE_INSTALL:append = " kernel-devicetree kernel-image-image"
do_image_wic[depends] += "mtools-native:do_populate_sysroot dosfstools-native:do_populate_sysroot"
IMAGE_BOOT_FILES ?= " Image fsl-ls1028a-rdb.dtb fsl-ls1028a-rdb-dpdk.dtb"

# it's used by many recipes in meta-freescale
MACHINE_SOCARCH = "${TUNE_PKGARCH}"

# pull in the meta-freescale layer.
BSP_NXP_DERIVED:append:nxp-ls1028  = " nxp-ls1028"

PREFERRED_PROVIDER_virtual/kernel ??= "linux-yocto"
PREFERRED_VERSION_linux-yocto ?= "6.12%"
PREFERRED_VERSION_dpdk = "22.11"

CUSTOMER_BUILD_BOOTLOADER ?= "0"
SDK_MACHINE = "ls1028ardb"
UBOOT_CONFIG ??= "tfa-secure-boot tfa"
UBOOT_CONFIG[tfa-secure-boot] = "ls1028ardb_tfa_SECURE_BOOT_defconfig"
UBOOT_CONFIG[tfa] = "ls1028ardb_tfa_defconfig"
RCWSD ?= "R_SQPP_0x85bb/rcw_1500_gpu600"
RCWXSPI ?= "R_SQPP_0x85bb/rcw_1500_gpu600"
RCWEMMC ?= "R_SQPP_0x85bb/rcw_1500_gpu600"
EXTRA_IMAGEDEPENDS:append = " ${@bb.utils.contains('CUSTOMER_BUILD_BOOTLOADER', '1', 'rcw qoriq-atf dp-firmware-cadence', '', d)}"
PREFERRED_PROVIDER_u-boot ??= "u-boot-qoriq"
MACHINEOVERRIDES:prepend = "${@bb.utils.contains('CUSTOMER_BUILD_BOOTLOADER', '1', \
									'qoriq:qoriq-arm64:ls1028a:ls1028ardb:', '', d)}"
do_image_wic[depends] += "${@bb.utils.contains('CUSTOMER_BUILD_BOOTLOADER', '1', 'secure-boot-qoriq:do_deploy', '', d)}"

# The loader is flashed into the device separately and not part of the SD image
OSTREE_BOOTLOADER_INCLUDE ?= ""
OSTREE_SD_UBOOT_WIC1 ?= ""
OSTREE_SD_UBOOT_WIC2 ?= ""
OSTREE_SD_UBOOT_WIC3 ?= ""
OSTREE_SD_UBOOT_WIC4 ?= ""

DEFAULT_DTB = "fsl-ls1028a-rdb.dtb"

# Because of the size of boot loader is ~64M and it must be added
# to 64
OSTREE_WKS_EFI_SIZE ?= "--size=128M"
OSTREE_FDISK_FSZ ?= "128"

OSTREE_UBOOT_CMD ?= "booti"
INITRAMFS_IMAGE ??= ""
IMAGE_BOOT_FILES:append = " \
    ${@bb.utils.contains('DISTRO_FEATURES', 'ostree', 'boot.scr', '', d)} \
    ${@bb.utils.contains('DISTRO_FEATURES', 'ostree', '${INITRAMFS_IMAGE}-${MACHINE}.${INITRAMFS_FSTYPES};initramfs', '', d)} \
"
OSTREE_KERNEL ?= "Image"
OSTREE_COPY_IMAGE_BOOT_FILES = "1"
OSTREE_BOOTSCR_PRECMD ?= "\
setenv loadaddr \${kernel_addr_r}; \
setenv initrd_addr \${ramdisk_addr_r}; \
setenv fdt_addr \${fdt_addr_r}; \
setenv no_menu yes; \
setenv console ttyS0; \
setenv no_fatwrite yes; \
"

# For ustart.img
OSTREE_NETINST_DEV ?= "/dev/mmcblk0,/dev/sda,/dev/vda"
OSTREE_NETINST_ARGS ?= " \
    ${OSTREE_CONSOLE} bl=ufsd rdinit=/install \
    instdev=${OSTREE_NETINST_DEV} instname=wrlinux \
    instbr=\$BRANCH insturl=\$URL instab=${OSTREE_USE_AB} \
    instsf=1 instdate=BUILD_DATE \
"
```
